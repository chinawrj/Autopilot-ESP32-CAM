## main/Kconfig.projbuild
```kconfig
menu "WiFi Configuration"

    config ESP_WIFI_SSID
        string "WiFi SSID"
        default "DEFAULT_SSID"
        help
            WiFi network name.
            Override via menuconfig or tools/provision-wifi.sh.

    config ESP_WIFI_PASSWORD
        string "WiFi Password"
        default "DEFAULT_PASS"
        help
            WiFi password.
            Override via menuconfig or tools/provision-wifi.sh.

    config ESP_WIFI_MAXIMUM_RETRY
        int "Maximum retry"
        default 5
        help
            Maximum number of retries before giving up WiFi connection.
            After max retries, the device will keep trying with longer intervals.

endmenu
```

## sdkconfig.defaults
```kconfig
# Autopilot ESP32-CAM — sdkconfig defaults
# 此文件不含敏感信息，可安全提交到 Git

# --- Target ---
CONFIG_IDF_TARGET="esp32"

# --- Flash ---
CONFIG_ESPTOOLPY_FLASHSIZE_8MB=y
CONFIG_ESPTOOLPY_FLASHMODE_QIO=y
CONFIG_ESPTOOLPY_FLASHFREQ_80M=y

# --- PSRAM ---
CONFIG_ESP32_SPIRAM_SUPPORT=y
CONFIG_SPIRAM=y
CONFIG_SPIRAM_TYPE_AUTO=y
CONFIG_SPIRAM_SPEED_80M=y
CONFIG_SPIRAM_USE_CAPS_ALLOC=y

# --- Partition table ---
CONFIG_PARTITION_TABLE_CUSTOM=y
CONFIG_PARTITION_TABLE_CUSTOM_FILENAME="partitions.csv"

# --- WiFi ---
CONFIG_ESP_WIFI_SSID="DEFAULT_SSID"
CONFIG_ESP_WIFI_PASSWORD="DEFAULT_PASS"
CONFIG_ESP_WIFI_MAXIMUM_RETRY=5

# --- Log level ---
CONFIG_LOG_DEFAULT_LEVEL_INFO=y

# --- Task watchdog ---
CONFIG_ESP_TASK_WDT_TIMEOUT_S=10

# --- Camera (for future use) ---
# XCLK frequency
# CONFIG_XCLK_FREQ=20000000

# --- FreeRTOS ---
CONFIG_FREERTOS_HZ=1000
```
